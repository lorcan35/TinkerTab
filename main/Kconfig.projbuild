## main/Kconfig.projbuild
```kconfig
menu "TinkerClaw Tab5 Configuration"

    config TAB5_WIFI_SSID
        string "WiFi SSID"
        default "YourWiFi"
        help
            WiFi network name (same LAN as Dragon).

    config TAB5_WIFI_PASS
        string "WiFi Password"
        default "YourPassword"
        help
            WiFi password.

    config TAB5_DRAGON_HOST
        string "Dragon IP Address"
        default "192.168.1.89"
        help
            IP address of the Dragon Q6A on the local network.

    config TAB5_DRAGON_PORT
        int "Dragon Streaming Port"
        default 3501
        help
            Port for the streaming server on Dragon.

    config TAB5_DRAGON_TOKEN
        string "Dragon API bearer token"
        default "CHANGEME_SET_IN_SDKCONFIG_LOCAL"
        help
            Bearer token sent on the /ws/voice upgrade request.  Must
            match Dragon's server.api_token (DRAGON_API_TOKEN env in
            /home/radxa/.env).  Leave the placeholder in sdkconfig.defaults
            and override in sdkconfig.local (gitignored).

endmenu
```

## sdkconfig.defaults
```kconfig
# TinkerClaw Tab5 — ESP32-P4 defaults (Phase 1.5)
# Matched to M5Stack Tab5 BSP sdkconfig

# Flash — Tab5 has 16MB QIO flash
CONFIG_ESPTOOLPY_FLASHMODE_QIO=y
CONFIG_ESPTOOLPY_FLASHSIZE_16MB=y

# Compiler — performance optimized
CONFIG_COMPILER_OPTIMIZATION_PERF=y

# PSRAM — 200MHz, XIP enabled (critical for MIPI DSI framebuffer DMA)
CONFIG_SPIRAM=y
CONFIG_SPIRAM_SPEED_200M=y
CONFIG_SPIRAM_XIP_FROM_PSRAM=y

# L2 Cache — 256KB with 128-byte lines (needed for DSI video streaming)
CONFIG_CACHE_L2_CACHE_256KB=y
CONFIG_CACHE_L2_CACHE_LINE_128B=y

# Larger main task stack (display + LVGL + all driver inits need room)
CONFIG_ESP_MAIN_TASK_STACK_SIZE=16384

# FreeRTOS tick rate
CONFIG_FREERTOS_HZ=1000

# Task WDT — 60s timeout (settings screen creation takes 5-10s with feed_wdt yields)
CONFIG_ESP_TASK_WDT_TIMEOUT_S=60

# ---------------------------------------------------------------------------
# Wave 13 C5: Brownout detector
# ESP32-P4 on USB-powered Tab5 experiences supply dips during WiFi TX peaks.
# Without a brownout detector the CPU runs through the dip and can silently
# corrupt PSRAM / RAM / PC — observable as a "stuck LVGL" state with no reboot.
# Brownout detector reboots cleanly on voltage drop instead, and the
# wave-11 coredump path captures it for post-mortem.
# ---------------------------------------------------------------------------
CONFIG_ESP_BROWNOUT_DET=y
CONFIG_ESP_BROWNOUT_DET_LVL_SEL_0=y
CONFIG_ESP_BROWNOUT_DET_LVL=0

# Partition table — custom for 16MB flash (4MB app + 12MB storage)
CONFIG_PARTITION_TABLE_CUSTOM=y
CONFIG_PARTITION_TABLE_CUSTOM_FILENAME="partitions.csv"

# USB console (JTAG/serial)
CONFIG_ESP_CONSOLE_USB_SERIAL_JTAG=y

# Experimental features (required for some MIPI DSI APIs)
CONFIG_IDF_EXPERIMENTAL_FEATURES=y

# ---------------------------------------------------------------------------
# ESP-Hosted — ESP32-C6 WiFi co-processor via SDIO
# Requires ESP-IDF v5.4.3+ for PSRAM XIP + TCM stack fixes
# ---------------------------------------------------------------------------
# Tab5 SDIO pin mapping (different from P4 EV Board defaults!)
CONFIG_ESP_HOSTED_SDIO_PIN_CLK=12
CONFIG_ESP_HOSTED_SDIO_PIN_CMD=13
CONFIG_ESP_HOSTED_SDIO_PIN_D0=11
CONFIG_ESP_HOSTED_SDIO_PRIV_PIN_D1_4BIT_BUS=10
CONFIG_ESP_HOSTED_SDIO_PIN_D2=9
CONFIG_ESP_HOSTED_SDIO_PIN_D3=8
CONFIG_ESP_HOSTED_SDIO_GPIO_RESET_SLAVE=15
# Tab5 C6 reset is active LOW (confirmed from M5Stack UserDemo sdkconfig)
CONFIG_ESP_HOSTED_SDIO_RESET_ACTIVE_LOW=y
# Slave target is ESP32-C6
CONFIG_ESP_HOSTED_IDF_SLAVE_TARGET="esp32c6"
CONFIG_SLAVE_IDF_TARGET_ESP32C6=y

# ---------------------------------------------------------------------------
# WiFi credentials and Dragon server — PLACEHOLDERS ONLY.
#
# Wave 13 SECURITY FIX: never commit real WiFi creds to a public repo.
# Override via `sdkconfig.local` (already in .gitignore) which the ESP-IDF
# build system merges on top of this file.
#
# Bootstrap:
#   cp sdkconfig.local.example sdkconfig.local
#   # edit sdkconfig.local with your real SSID + password + Dragon host
#   idf.py fullclean build
#
# The old placeholders leaked in git history (commits 29699e2 onward).
# If you forked this tree you MUST rotate the WiFi password on your
# router; the old string is part of the public repo history forever.
# ---------------------------------------------------------------------------
CONFIG_TAB5_WIFI_SSID="CHANGEME_SET_IN_SDKCONFIG_LOCAL"
CONFIG_TAB5_WIFI_PASS="CHANGEME_SET_IN_SDKCONFIG_LOCAL"
CONFIG_TAB5_DRAGON_HOST="192.168.1.91"
CONFIG_TAB5_DRAGON_PORT=3502
# Wave 14 W14-C04: bearer token for the /ws/voice upgrade request.
# Must match Dragon's server.api_token (DRAGON_API_TOKEN env).
# Override in sdkconfig.local, do NOT commit a real value.
CONFIG_TAB5_DRAGON_TOKEN="CHANGEME_SET_IN_SDKCONFIG_LOCAL"

# ---------------------------------------------------------------------------
# LVGL Configuration
# ---------------------------------------------------------------------------
CONFIG_LV_COLOR_DEPTH_16=y
CONFIG_LV_FONT_MONTSERRAT_12=y
CONFIG_LV_FONT_MONTSERRAT_14=y
CONFIG_LV_FONT_MONTSERRAT_16=y
CONFIG_LV_FONT_MONTSERRAT_18=y
CONFIG_LV_FONT_MONTSERRAT_20=y
CONFIG_LV_FONT_MONTSERRAT_24=y
CONFIG_LV_FONT_MONTSERRAT_28=y
CONFIG_LV_FONT_MONTSERRAT_36=y
CONFIG_LV_FONT_MONTSERRAT_48=y
CONFIG_LV_USE_LOG=y
CONFIG_LV_LOG_LEVEL_WARN=y
CONFIG_LV_THEME_DEFAULT_DARK=y
CONFIG_LV_DRAW_SW_CIRCLE_CACHE_SIZE=32
# TT #507 — LVGL refresh period (orb breath needs sub-33 ms ticks to
# feel smooth).  Default 33 ms = 30 Hz target; dropping to 16 ms = 60 Hz
# target.  The DPI panel + PSRAM partial buffers handle this without
# tearing.  Empirically Tab5 idle FPS hits ~45-85 at 33 ms; at 16 ms
# the engine has the budget to run animations at the panel's natural
# refresh rate.  No measurable CPU penalty at idle (anim work is per-
# tick; the tick rate itself is cheap).
CONFIG_LV_DEF_REFR_PERIOD=16
# LVGL memory.  Base pool is 64 KB statically in BSS; the real working
# heap comes from a 2 MB PSRAM-backed lv_mem_add_pool() at boot in main.c
# (see #183 + docs/STABILITY-INVESTIGATION.md).  History: 2026-04-17 had
# 64 KB (xPortcheckValidStackMem assert at 96 KB on some builds), later
# bumped to 96 in a prior cycle when the PSRAM pool wasn't yet in place;
# now that main.c adds 2 MB from PSRAM at boot the 64 KB base is plenty
# and restoring 64 KB here frees 32 KB of BSS for internal-SRAM pressure
# relief (#182).  The POOL_EXPAND_SIZE number below is only a TLSF
# per-pool max-size ceiling, not an auto-expand trigger — see CLAUDE.md.
CONFIG_LV_MEM_SIZE_KILOBYTES=64
CONFIG_LV_MEM_POOL_EXPAND_SIZE_KILOBYTES=4096
# Disable LVGL assert on malloc failure — default while(1) hangs 60s then WDT kills device
CONFIG_LV_USE_ASSERT_NULL=n
CONFIG_LV_USE_ASSERT_MALLOC=n

# ---------------------------------------------------------------------------
# Crash diagnostics and stability
# ---------------------------------------------------------------------------
CONFIG_ESP_COREDUMP_ENABLE_TO_FLASH=y
CONFIG_ESP_COREDUMP_DATA_FORMAT_ELF=y
CONFIG_ESP_COREDUMP_MAX_TASKS_NUM=64
CONFIG_ESP_COREDUMP_CHECKSUM_CRC32=y
CONFIG_ESP_COREDUMP_ENABLE_TO_NONE=
CONFIG_ESP_TASK_WDT_PANIC=y
CONFIG_HEAP_POISONING_DISABLED=y
CONFIG_HEAP_POISONING_LIGHT=
# Wave 15 leak hunt — enable standalone heap tracing so /debug/heap_trace_*
# endpoints can capture live alloc/free records and surface which caller is
# leaking internal SRAM over time.
CONFIG_HEAP_TRACING_OFF=
CONFIG_HEAP_TRACING_STANDALONE=y
CONFIG_HEAP_TRACING=y
# IDLE task: 2048 (stock-compatible). 4096 was pushing internal SRAM over the
# cliff on fresh builds → xPortcheckValidStackMem assert (stacks fell to PSRAM).
# vTaskDelete(NULL) is banned on P4 anyway (use vTaskSuspend — issue #20).
CONFIG_FREERTOS_IDLE_TASK_STACKSIZE=2048
# Let RTC FAST memory also serve as internal-capable heap (extra pool for
# early static-task allocations).
CONFIG_ESP_SYSTEM_ALLOW_RTC_FAST_MEM_AS_HEAP=y
# Default 4096 was crashing on builds that pulled in the UART driver
# (which links esp_ringbuf and shifts internal-RAM layout enough that
# pvPortMalloc(16KB) for the timer task stack returns NULL —
# port_common.c:97 assert).  2048 matches stock FreeRTOS, halves the
# allocation, and was already the precedent for the IDLE task above.
CONFIG_FREERTOS_TIMER_TASK_STACK_DEPTH=2048

# Move the bulk of esp_ringbuf out of IRAM (saves ~2 KB) — pressure
# relief that pairs with the timer-task stack reduction above.  Tab5
# never reads from ring buffers in IRAM ISR context.
CONFIG_RINGBUF_PLACE_FUNCTIONS_INTO_FLASH=y
# Disable TLSP deletion callbacks — esp_ptr_executable() false positive on P4
# with PSRAM XIP (.text at 0x4800xxxx not recognized as executable) (#18)
CONFIG_FREERTOS_TLSP_DELETION_CALLBACKS=n

# ---------------------------------------------------------------------------
# Memory — reserve internal RAM for DMA (SDIO WiFi + TCP buffers + OTA TLS)
# Wave 10 #77 fix: bumped 64 KB -> 128 KB so the esp_https_ota flow has
# headroom for its internal TLS/HTTP buffers even after 5+ minutes of
# steady-state operation.  At 64 KB the DMA-capable free pool dwindled
# to ~8 KB by the time a user tapped "Apply Update" and
# esp_dma_capable_malloc failed at 181 bytes.  128 KB leaves enough
# runway for OTA, WS, SDIO RX, and HTTP debug server to coexist.
# ---------------------------------------------------------------------------
CONFIG_SPIRAM_MALLOC_RESERVE_INTERNAL=131072

# ---------------------------------------------------------------------------
# SDIO WiFi stability — tuned for concurrent WS + HTTP traffic
# ---------------------------------------------------------------------------
CONFIG_ESP_HOSTED_DFLT_TASK_STACK=12288
CONFIG_ESP_HOSTED_RPC_TASK_STACK=12288
# Reduce SDIO RX queue depth to free ~30KB DMA heap for TCP buffers
CONFIG_ESP_HOSTED_SDIO_RX_Q_SIZE=20
CONFIG_ESP_SDIO_RX_Q_SIZE=20

# ---------------------------------------------------------------------------
# lwIP TCP — sized for concurrent voice WS + HTTP debug server
# ---------------------------------------------------------------------------
CONFIG_LWIP_MAX_SOCKETS=24
CONFIG_LWIP_TCP_SND_BUF_DEFAULT=32768
CONFIG_LWIP_TCP_WND_DEFAULT=32768
CONFIG_LWIP_TCP_RECVMBOX_SIZE=12
CONFIG_LWIP_TCP_ACCEPTMBOX_SIZE=12
CONFIG_LWIP_TCP_OOSEQ_MAX_PBUFS=8
CONFIG_LWIP_TCPIP_TASK_STACK_SIZE=4096
# Pin LWIP to Core 1 — prevents TCP starvation during heavy LVGL rendering on Core 0.
# Settings creates 55 objects which blocks Core 0 for ~1s. Without this, LWIP
# gravitates to Core 0 and can't process SYN-ACK, causing 8s HTTP timeouts.
CONFIG_LWIP_TCPIP_TASK_AFFINITY_CPU1=y
# Camera SC202CS sensor
CONFIG_CAMERA_SC202CS=y
CONFIG_CAMERA_SC202CS_AUTO_DETECT=y
CONFIG_CAMERA_SC202CS_AUTO_DETECT_MIPI_INTERFACE_SENSOR=y
CONFIG_CAMERA_SC202CS_MIPI_RAW8_1280x720_30FPS=y
CONFIG_CAMERA_SC202CS_MIPI_IF_FORMAT_INDEX_DAFAULT=0

# LVGL TJPGD — JPEG decoder for media cache image rendering
CONFIG_LV_USE_TJPGD=y
# Memory-mapped FS — required for TJPGD to decode JPEG from RAM buffers
CONFIG_LV_USE_FS_MEMFS=y
CONFIG_LV_FS_MEMFS_LETTER=77
# Wave 5 (audit J2): allow OTA over plain HTTP.  Tab5 talks to Dragon on LAN
# without HTTPS; MitM defense is the version.json-carried SHA256 hash verified
# in ota.c after download.  Without this flag esp_https_ota_begin refuses http://.
CONFIG_ESP_HTTPS_OTA_ALLOW_HTTP=y

# --- Wave 15 #134: route mbedtls allocations to PSRAM ---
# Default CONFIG_MBEDTLS_INTERNAL_MEM_ALLOC fails after ~15 min uptime
# because internal SRAM fragments below the ~20 KB contiguous block
# that SSL_setup needs.  PSRAM has 20+ MB free, zero fragmentation
# issue, and mbedtls handles the cache coherency correctly.  This
# fixes conn_mode=2 (ngrok / internet-only) being unusable after
# extended LAN use.
CONFIG_MBEDTLS_EXTERNAL_MEM_ALLOC=y
```

## sdkconfig.defaults.esp32p4
```kconfig
# ESP32-P4 specific defaults (hardware target)
CONFIG_ESPTOOLPY_FLASHMODE_QIO=y
CONFIG_ESPTOOLPY_FLASHSIZE_16MB=y
CONFIG_SPIRAM=y
CONFIG_SPIRAM_SPEED_200M=y
CONFIG_SPIRAM_XIP_FROM_PSRAM=y
CONFIG_CACHE_L2_CACHE_256KB=y
CONFIG_CACHE_L2_CACHE_LINE_128B=y
CONFIG_ESP_CONSOLE_USB_SERIAL_JTAG=y
CONFIG_IDF_EXPERIMENTAL_FEATURES=y
```

## sdkconfig.defaults.linux
```kconfig
# Linux target — SDL2 display backend
CONFIG_LV_USE_SDL=y
CONFIG_LV_COLOR_DEPTH_32=y
```
